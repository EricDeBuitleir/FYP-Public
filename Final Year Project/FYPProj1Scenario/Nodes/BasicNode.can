/*@!Encoding:1252*/
/*@!Encoding:1252*/
/*@!Encoding:1252*/
includes
{
  #include "..\DataSources_Templates\ASNV_Template_BaseDatatypes.cin"
  #include "..\DataSources_Templates\ASNV_Template_CAM.cin"
  #include "..\DataSources_Templates\ASNV_Template_DENM.cin"
  #include "..\DataSources_Templates\ASNV_Template_MAP.cin"
  #include "..\DataSources_Templates\ASNV_Template_SPAT.cin"
  #include "..\DataSources_Templates\ASNV_Template_IVIM.cin"
  #include "Position.cin"
 // #include "<math.h>"
//  #include "studio.h"
  
}





variables
{
    double vehicleCamLong = 0;
    double vehicleCamLat = 0;
    long stopVehicle = 0;
    double followSpeed = 0;
    long trafficLightState = 0; // 0 = Green, 1 = Yellow, 2 = Red
    int carStationType;
    int carStationId;
    int ledState = 0;
    msTimer lightTimer;
    int carSteerAngle = 0;
    int junctionLength = 30;
    int junctionWidth = 30;
    int junctionHeight = 100;
    int carPositionLat = 0;
    int carPositionLong = 0;
    int isApproachingJunction = 0;
    int isTurningAllowed = 0;
    int sendProcessSignal;
    int laneBoundaries[4][2] = {{100, 50}, {300, 50}, {300, 100}, {100, 100}};
    int carPositionX = 0; 
    int carPositionY = 0; 
    int previousCarX = 0;
    int previousCarY = 0;
    int carSteeringAngle =0;
    int carSteeringAng = 0;
    int rsuPositionsX;
    int rsuPositionsY;
  
    int dimensions;
    int junction = 0;
    int laneId;
//    double lane1X = 52.2460217;
//    double lane1Y = -7.1280347;
     double lane1X = -7.128107;
    double lane1Y = 52.246004;
    
    struct Lane {
      int id;
      int startX;
      int startY;
      int endX;
      int endY;  
  };
  
   const int numLanes = 4;
  struct Lane currentLane;
  struct Lane lanes[numLanes];

//  struct Lane lanes[4] = {
//    {1, 100, 50, 300, 50}
//  };

  
  
  
}


// On start, callback functions for the most common application messages CAM and DENM are registered.
// It is possible to do the same with the other application messages if needed.

on start
{
  enum CallbackType { OnRx, PreTx };
  
  C2xRegisterCallback(OnRx,  "OnRxCAM",    "CAM");
  C2xRegisterCallback(PreTx, "OnPreTxCAM", "CAM");
  
  C2xRegisterCallback(OnRx,  "OnRxDENM",    "DENM");
  C2xRegisterCallback(PreTx, "OnPreTxDENM", "DENM");
  //setTimer(lightTimer, 0);


}

// Callback function on receiving CAM messages
void OnRxCAM(long channel, long dir, long radioChannel, long signalStrength, long signalQuality, long packet)
{
  struct CAM camPdu;     
  
  double camLong;        
  double camLat;         
  long camStationType;   
  double distanceToCam;   
  long camSpeed;        
  long camHeading;      
  long camStationId;
  long leadSpeed;
 
  long carSpeed;


  if (!API_GetCAMParams(packet, camPdu))
  {

    camSpeed = camPdu.cam.camParameters.highFrequencyContainer.basicVehicleContainerHighFrequency.speed.speedValue;
    camLong = camPdu.cam.camParameters.basicContainer.referencePosition.longitude / 1e07;
    camLat = camPdu.cam.camParameters.basicContainer.referencePosition.latitude / 1e07;
    
     carPositionX = (int)(camLong * 1e7); 
      carPositionY = (int)(camLat * 1e7); 
    
    // detmine the lane ID based on function below
    
 //   laneId = setLaneId(camLong, camLat, 0, 0);
    laneId = setLaneId(camLong, camLat);
 
// Enumeration values for stationType: 
// -------------------------------------------------------------
// 0 : unknown
// 1 : pedestrian
// 2 : cyclist
// 3 : moped
// 4 : motorcycle
// 5 : passengerCar
// 6 : bus
// 7 : lightTruck
// 8 : heavyTruck
// 9 : trailer
// 10 : specialVehicles
// 11 : tram
// 15 : roadSideUnit
// -------------------------------------------------------------
carStationType = camPdu.cam.camParameters.basicContainer.stationType;
carStationId = camPdu.header.stationID;

   
// Enumeration values for speedValue: 
// -------------------------------------------------------------
// 16383 : unavailable
// -------------------------------------------------------------
   carSpeed = camPdu.cam.camParameters.highFrequencyContainer.basicVehicleContainerHighFrequency.speed.speedValue;
   carSteerAngle = camPdu.cam.camParameters.highFrequencyContainer.basicVehicleContainerHighFrequency.steeringWheelAngle.steeringWheelAngleValue;
 
 
    distanceToCam = API_PosCalcDistance(vehicleCamLat, vehicleCamLong, camLat, camLong);
//    distanceToCam = API_PosCalcDistance(carPositionX, carPositionY, lane1X, lane1Y);
    
  
    // Debug print statement to check the conditions
    //write("Debug: distanceToCam = %f, camSpeed = %d, stationType = %d, stationID = %d ", distanceToCam, camSpeed, carStationType, carStationId);
//      write("Debug: vehicleCamLat: %f, vehicleCamLong: %f", vehicleCamLat, vehicleCamLong);
//      write("Debug: camLat: %f, camLong: %f", camLat, camLong);
//      write("Debug: Distance to Cam: %f", distanceToCam);
 //       write("Debug: Steering wheel angle : %f", distanceToCam);
//     write("Test: Car ID %d has %d steeting wheel angle. ", carStationId, carSteerAngle);
    
    
    // CHECK CONDITIONS FOR RSU BASED ON SPEED AND POSITION
    if (distanceToCam <= 10 && distanceToCam > 0 && carStationType == 5 && carSpeed > 0) {
        //defineLaneBoundaries(45, 1, carPositionX, carPositionY, camPdu, lane1X, lane1Y);
        defineLaneBoundaries(carPositionX, carPositionY, carSteerAngle);
      
        @sysvar::distanceToCam::distanceToCam = 1;
        setTimer(lightTimer, 0);
        // CheckRSUAndLED();
    }

    
//    else
    
//        @sysvar::distanceToCam::distanceToCam = 0;
    
  
   }
}


// Callback function before sending CAM messages from IL
void OnPreTxCAM(LONG packet)
{
    struct CAM camPdu; 
  
    // Save the current vehicle's co-ordinates for future distance calculations.
  
    if (!API_GetCAMParams(packet, camPdu))
     {
        vehicleCamLong = camPdu.cam.camParameters.basicContainer.referencePosition.longitude / 1e07;
        vehicleCamLat = camPdu.cam.camParameters.basicContainer.referencePosition.latitude / 1e07;
        followSpeed = camPdu.cam.camParameters.highFrequencyContainer.basicVehicleContainerHighFrequency.speed.speedValue;
        
       //` write(" *** Vehicle long = %f lat = %f \n",  vehicleCamLong,  vehicleCamLat );
     }
    
  
    
}

// Callback function on receiving DENM messages
void OnRxDENM(long channel, long dir, long radioChannel, long signalStrength, long signalQuality, long packet)
{
  struct DENM denmPdu;
  int type;
  int stationId;
  
  write(" *** DENM Received ");
   if (!API_GetDENMparams(packet, denmPdu))
  {
    stationId = denmPdu.header.stationID;
    write(" DENM stationId = %d", stationId);
    type = denmPdu.denm.situation.eventType.causeCode;
    write(" DENM Cause Code = %d", type);
  }
    
}

// Callback function before sending DENM messages from IL
void OnPreTxDENM(LONG packet)
{

}



//on key 'x'
//{
  
//  /*
//    Example of how to transmit a DENM messaage.  Note that other parameters such as Station Id, relevance area etc. would need to be
//    included in a realistic DENM message.
//  */
  
//  long packet;
//  double eventPosLat, eventPosLon, eventPosElev;

//  eventPosLat = 48.8233831512772;
//  eventPosLon = 9.093631893371;
//  eventPosElev = 305;

//  packet = C2xInitPacket("DENM");
//  C2xSetTokenInt(packet, "DENM", "denm.situation.eventType.causeCode", 91); // VehicleBreakDown
//  C2xSetTokenPhys(packet, "DENM", "denm.management.eventPosition.latitude", eventPosLat);
//  C2xSetTokenPhys(packet, "DENM", "denm.management.eventPosition.longitude", eventPosLon);
//  C2xSetTokenPhys(packet, "DENM", "denm.management.eventPosition.altitude.altitudeValue", eventPosElev);

// // C2xApplyPathHistory(packet, eventPosLat, eventPosLon, 305, 800, 20, 1);

//  C2xCompletePacket(packet);
//  C2xOutputPacket(packet);
//}





void trafficLightGreen() {
    @sysvar::trafficLightState::trafficLightState = 0; // 0 = Green, 1 = Yellow, 2 = Red
}
void trafficLightYellow() {
    @sysvar::trafficLightState::trafficLightState = 1; // 0 = Green, 1 = Yellow, 2 = Red
}

void trafficLightRed() {
    @sysvar::trafficLightState::trafficLightState = 2; // 0 = Green, 1 = Yellow, 2 = Red
}

on timer lightTimer {
    switch (trafficLightState) {
        case 0: // Green
            trafficLightYellow(); // Light switches from green to yellow
              setTimer(lightTimer, 5000);
            break;
        case 1: // Yellow
            trafficLightRed();// Light switches from yellow to red
              setTimer(lightTimer, 30000);
            break;
        case 2: // Red
            trafficLightGreen();// Light switches from red to green
              setTimer(lightTimer, 20000);
            break;
            
    }
}

    


void VehiclePosition(long packet, struct CAM camPdu)
 {
  int vehiclePosition =0 ;

  int carPositionLat = 0;
  int carPositionLong = 0;
  int  carStationId;
  double camLong;        
  double camLat;         
  long camStationType;   
  double distanceToCam;   
  long camSpeed;        
  long camHeading;      
  long camStationId;
  long leadSpeed;
  
  long carSpeed;

   
   
if (!API_GetCAMParams(packet, camPdu))
    {
        // Extract relevant information from the CAM message
        carPositionLong = camPdu.cam.camParameters.basicContainer.referencePosition.longitude / 1e07;
        carPositionLat = camPdu.cam.camParameters.basicContainer.referencePosition.latitude / 1e07;
        carStationId = camPdu.header.stationID;
        carSteerAngle = camPdu.cam.camParameters.highFrequencyContainer.basicVehicleContainerHighFrequency.steeringWheelAngle.steeringWheelAngleValue;


    }
 }
 
 


void carWillContinueRight(struct CAM camPdu) {
    int carX = 0;
    int carY = 0;
    carX = camPdu.cam.camParameters.basicContainer.referencePosition.longitude / 1e07;
    carY = camPdu.cam.camParameters.basicContainer.referencePosition.latitude / 1e07;
    
    if (carX > previousCarX && carY < previousCarY) {
        write("Car is continuing to turn right.");
        
        previousCarX = carX;
        previousCarY = carY;
    } else {
        // Car is not continuing to turn right
        write("Car is not continuing to turn right.");
        // Implement additional actions here if needed
      
    }
}
 

  

//void defineLaneBoundaries(int carSteerAng, int laneId, int carPositionX, int carPositionY, struct CAM camPdu, double rsuPositionX, double rsuPositionY) {
//    int laneStartX, laneStartY, laneEndX, laneEndY;
    
//    carSteerAng = camPdu.cam.camParameters.highFrequencyContainer.basicVehicleContainerHighFrequency.steeringWheelAngle.steeringWheelAngleValue;
//    carPositionX = camPdu.cam.camParameters.basicContainer.referencePosition.longitude / 1e07;
//    carPositionY = camPdu.cam.camParameters.basicContainer.referencePosition.latitude / 1e07;
//    laneId = setLaneId(carPositionX, carPositionY, rsuPositionX, rsuPositionY);
//    if (laneId != -1) {
//      write("Debug: Lane ID = %d", laneId); // Debug print statement to check the lane ID
//  }



// =====================================================================================================================================

// WORKING ONE

//    // Define lane boundaries based on the laneId
//    switch (laneId) {
//        case 1: // left lane going up
//            laneStartX = 100;
//            laneStartY = 50;
//            laneEndX = 300;
//            laneEndY = 50;
//            break;
//        // Define boundaries for other lanes as needed
//    }
//    write("Debug: Car Position X = %d, Car Position Y = %d", carPositionX, carPositionY);
    
//    // Check if the car's position violates lane boundaries
//    if (carPositionX > laneStartX + 20 && carPositionX < laneEndX - 20 && carPositionY > laneStartY + 20 && carPositionY < laneEndY - 20) {
//        // Car is within the lane boundaries, check if it's lane 1
//        if (laneId == 1) {
//            // Car is in lane 1, check turning direction
//            if (carSteerAng >= 45) {
//                // Car is turning right while in lane 1, trigger a warning
//                write("Warning: Car is looking to turn right while in lane 1!");
//                // Signal that turning right is not allowed
//                trafficLightRed();
//            } else {
//                // Car is not turning right, reset signals
//                trafficLightGreen(); // Or any other appropriate action
//            }
//        }
//    } else {
//        // Car is outside lane boundaries, trigger a warning
//        write("Warning: Car is outside lane boundaries!");
//        // Signal that the car is outside lane boundaries        
//    }
//}
  

// =====================================================================================================================================

// NEW ONE

// Function to define lane boundaries and check car position
void defineLaneBoundaries(double carX, double carY, int carSteerAng) {
  
    
  
    int laneId = 0;
    int i;
    laneId = setLaneId(carX, carY);
    write("Debug: Car Position X = %f, Car Position Y = %f", carX, carY);
    if (laneId == -1) {
        // Car is not within any lane
        write("Warning: Car is not within any lane!");
        // Additional actions can be implemented here if needed
        return;
    }
    
    // Find the current lane based on laneId
    for (i = 0; i < numLanes; i++) {
        if (lanes[i].id == laneId) {
            currentLane.id = lanes[i].id;
            currentLane.startX = lanes[i].startX;
            currentLane.startY = lanes[i].startY;
            currentLane.endX = lanes[i].endX;
            currentLane.endY = lanes[i].endY;
            break;
        }
    }

    // Check if the car's position violates lane boundaries
    if (carX > currentLane.startX + 20 && carX < currentLane.endX - 20 &&
        carY > currentLane.startY + 20 && carY < currentLane.endY - 20) {
        // Car is within the lane boundaries
        if (laneId == 1 && carSteerAng >= 45) {
            // Car is turning right in lane 1
            write("Warning: Car is turning right in lane 1!");
            // Trigger additional actions if needed
        }
    } else {
        // Car is outside lane boundaries
        write("Warning: Car is outside lane boundaries!");
        // Trigger additional actions if needed
    }
}





// =====================================================================================================================================


// Going to have to make a method to define the lanes as well as which lane the car is in.
// Will use RSUs for reference point of where the lane is.
// Calculate the distance to the nearest RSU, using the formula shown here. REFERENCE: https://www.cuemath.com/euclidean-distance-formula/
  
  



// =====================================================================================================================================


// WORKING


//int setLaneId(double carX, double carY, int rsuPositionX, int rsuPositionY) {

//    // Array for our 4 lanes
//    double rsuPositionsX[4] = {100, 300, 300, 100};
//    double rsuPositionsY[4] = {50, 50, 100, 100};
 
//    int i;
//    double dMin = 0; // Initialize to maximum possible value
//    int closestRSU = -1; // Initialize to an invalid value since 0 could be a valid index
    
    
  
    
    
//    for (i = 0; i < 4; i++) {
//      double distance = 0;
//        // Calculate distance using Euclidean distance formula
////        distance = ((carX - rsuPositionsX[i]) * (carX - rsuPositionsX[i])) + ((carY - rsuPositionsY[i]) * (carY - rsuPositionsY[i]));  // had to hard code 'power' as trying to import math.h was crashing CANoe
//        distance = ((carX - (lanes[i].startX +  lanes[i].endX)) * (carX - (lanes[i].startX +  lanes[i].endX))) + ((carY - lanes[i].startY) * (carY - lanes[i].endY));  // had to hard code 'power' as trying to import math.h was crashing CANoe
      
//        if (distance < dMin) {
//            dMin = distance;
////            closestRSU = i;
//            closestRSU = lanes[i].id;
//        }
//    }
    
//    return closestRSU; // Return the closest RSU index
//}


// =====================================================================================================================================


// NEW ONE

// Function to calculate the closest lane to the car's position
int setLaneId(double carX, double carY) {
    int closestLaneId = -1;
    double dx;
    double dy;
    int i;
    double minDistanceSquared = 0; // Initialize to maximum possible value
    double distanceSquared = 0;

    // Iterate through all lanes to find the closest one
    for (i = 0; i < numLanes; i++) {
         dx = carX - lanes[i].startX;
         dy = carY - lanes[i].startY;
         distanceSquared = dx * dx + dy * dy;
        if (distanceSquared < minDistanceSquared) {
            minDistanceSquared = distanceSquared;
            closestLaneId = lanes[i].id;
        }
    }

    return closestLaneId;
}



// Function to calculate the square of a number

// =============================================


// ISSUES RIGHT NOW

// 1) Lane doesn't seem to be getting defined as constantly getting out of bounds
// 2) Steering wheel angle doesn't seem to be getting read.